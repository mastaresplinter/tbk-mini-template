/*
 * Copyright (c) 2022 Lau Kar Rui
 *
 * SPDX-License-Identifier: MIT
 */

#include "tbk_mini.dtsi"

/ {
    chosen {
        zmk,kscan = &kscan;
    };

    kscan: kscan {
        compatible = "zmk,kscan-gpio-matrix";
        wakeup-source;

        diode-direction = "row2col";
         /* Outputs: rows → no pulls */
         row-gpios
             = <&pro_micro 15 GPIO_ACTIVE_HIGH>
             , <&pro_micro 14 GPIO_ACTIVE_HIGH>
             , <&pro_micro 16 GPIO_ACTIVE_HIGH>
             , <&pro_micro 10 GPIO_ACTIVE_HIGH>
             ;

         /* Inputs: columns → pull-up + active-low */
         col-gpios
             = <&pro_micro 9  (GPIO_PULL_UP | GPIO_ACTIVE_LOW)>
             , <&pro_micro 8  (GPIO_PULL_UP | GPIO_ACTIVE_LOW)>
             , <&pro_micro 7  (GPIO_PULL_UP | GPIO_ACTIVE_LOW)>
             , <&pro_micro 6  (GPIO_PULL_UP | GPIO_ACTIVE_LOW)>
             , <&pro_micro 5  (GPIO_PULL_UP | GPIO_ACTIVE_LOW)>
             , <&pro_micro 4  (GPIO_PULL_UP | GPIO_ACTIVE_LOW)>
             ;
};

&default_transform {
    col-offset = <6>;
};
