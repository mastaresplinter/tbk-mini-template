## boards/shields/tbk_mini/Kconfig.defconfig
```kconfig
if SHIELD_TBK_MINI_LEFT

# Name must be less than 16 characters long!
config ZMK_KEYBOARD_NAME
    default "tbk-mini-mn"

config ZMK_SPLIT_ROLE_CENTRAL
    default y

endif

if SHIELD_TBK_MINI_LEFT || SHIELD_TBK_MINI_RIGHT

config ZMK_SPLIT
    default y

endif
```
