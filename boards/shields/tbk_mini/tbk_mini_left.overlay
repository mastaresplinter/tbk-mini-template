/*
 * Copyright (c) 2022 Lau Kar Rui
 *
 * SPDX-License-Identifier: MIT
 */

#include "tbk_mini.dtsi"

/ {
    chosen {
        zmk,kscan = &kscan;
    };

    kscan: kscan {
        compatible = "zmk,kscan-gpio-matrix";
        wakeup-source;

        diode-direction = "row2col";

         /* Rows are OUTPUTS when row2col; no pulls needed on outputs */
         row-gpios
             = <&pro_micro 6  GPIO_ACTIVE_HIGH>
             , <&pro_micro 7  GPIO_ACTIVE_HIGH>
             , <&pro_micro 8  GPIO_ACTIVE_HIGH>
             , <&pro_micro 9  GPIO_ACTIVE_HIGH>
             ;

         /* Columns are INPUTS when row2col; give them PULL_UP + ACTIVE_LOW */
         col-gpios
             = <&pro_micro 16 (GPIO_PULL_UP | GPIO_ACTIVE_LOW)>
             , <&pro_micro 10 (GPIO_PULL_UP | GPIO_ACTIVE_LOW)>
             , <&pro_micro 14 (GPIO_PULL_UP | GPIO_ACTIVE_LOW)>
             , <&pro_micro 15 (GPIO_PULL_UP | GPIO_ACTIVE_LOW)>
             , <&pro_micro 18 (GPIO_PULL_UP | GPIO_ACTIVE_LOW)>
             , <&pro_micro 19 (GPIO_PULL_UP | GPIO_ACTIVE_LOW)>
             ;
    };
};
